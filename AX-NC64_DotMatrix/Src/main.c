/* USER CODE BEGIN Header */
/**
  ******************************************************************************
  * @file           : main.c
  * @brief          : Main program body
  ******************************************************************************
  * @attention
  *
  * <h2><center>&copy; Copyright (c) 2019 STMicroelectronics.
  * All rights reserved.</center></h2>
  *
  * This software component is licensed by ST under BSD 3-Clause license,
  * the "License"; You may not use this file except in compliance with the
  * License. You may obtain a copy of the License at:
  *                        opensource.org/licenses/BSD-3-Clause
  *
  ******************************************************************************
  */
/* USER CODE END Header */

/* Includes ------------------------------------------------------------------*/
#include "main.h"

/* Private includes ----------------------------------------------------------*/
/* USER CODE BEGIN Includes */
#include <stdio.h>
#include <string.h>
/* USER CODE END Includes */

/* Private typedef -----------------------------------------------------------*/
/* USER CODE BEGIN PTD */

/* USER CODE END PTD */

/* Private define ------------------------------------------------------------*/
/* USER CODE BEGIN PD */

/* USER CODE END PD */

/* Private macro -------------------------------------------------------------*/
/* USER CODE BEGIN PM */
// Internal Macros
#define HEX__(n) 0x##n##LU
#define B8__(x) ((x&0x0000000FLU)?1:0) \
+((x&0x000000F0LU)?2:0) \
+((x&0x00000F00LU)?4:0) \
+((x&0x0000F000LU)?8:0) \
+((x&0x000F0000LU)?16:0) \
+((x&0x00F00000LU)?32:0) \
+((x&0x0F000000LU)?64:0) \
+((x&0xF0000000LU)?128:0)

// User-visible Macros
#define B8(d) ((unsigned char)B8__(HEX__(d)))
#define B16(dmsb,dlsb) (((unsigned short)B8(dmsb)<<8) + B8(dlsb))
#define B32(dmsb,db2,db3,dlsb) \
(((unsigned long)B8(dmsb)<<24) \
+ ((unsigned long)B8(db2)<<16) \
+ ((unsigned long)B8(db3)<<8) \
+ B8(dlsb))
/* USER CODE END PM */

/* Private variables ---------------------------------------------------------*/
TIM_HandleTypeDef htim2;

/* USER CODE BEGIN PV */

/* USER CODE END PV */

/* Private function prototypes -----------------------------------------------*/
void SystemClock_Config(void);
static void MX_GPIO_Init(void);
static void MX_TIM2_Init(void);
/* USER CODE BEGIN PFP */
uint8_t font_6_8[] = {
	0x00, 0x00, 0x00, 0x00, 0x00, 0x00,  // 0x00
	0x00, 0x7c, 0xa2, 0x8a, 0xa2, 0x7c,  // 0x01
	0x00, 0x7c, 0xd6, 0xf6, 0xd6, 0x7c,  // 0x02
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	0x00, 0x00, 0x00, 0x00, 0x00, 0x00  // 0xff
};

uint8_t font_A[] = {
	0x3c, 0x42, 0x42, 0x42, 0x7e, 0x42, 0x42, 0x00
};


/* USER CODE END PFP */

/* Private user code ---------------------------------------------------------*/
/* USER CODE BEGIN 0 */
void shiftOut(uint8_t data) {
	HAL_GPIO_WritePin(C_LD_GPIO_Port, C_LD_Pin, 0); // Set CS to LOW
  for (int ibit=7;ibit>=0;ibit--) {
    HAL_GPIO_WritePin(C_DT_GPIO_Port, C_DT_Pin, (data>>ibit)&0x01);
    
		HAL_GPIO_WritePin(C_CLK_GPIO_Port, C_CLK_Pin, 1);
		HAL_GPIO_WritePin(C_CLK_GPIO_Port, C_CLK_Pin, 0);
  }
  HAL_GPIO_WritePin(C_LD_GPIO_Port, C_LD_Pin, 1); // Set CS to HIGH
}

void resetCounter() {
	HAL_GPIO_WritePin(R_RST_GPIO_Port, R_RST_Pin, 1);
	HAL_GPIO_WritePin(R_RST_GPIO_Port, R_RST_Pin, 0);
}

void tickClock() {
	HAL_GPIO_WritePin(R_CLK_GPIO_Port, R_CLK_Pin, 1);
	HAL_GPIO_WritePin(R_CLK_GPIO_Port, R_CLK_Pin, 0);
}

void scan_dotmatrix(uint8_t *data) {
  for (int i=0;i<8;i++) {
    shiftOut(~data[i]);
    tickClock();
    HAL_Delay(1);
  }
  resetCounter();
}

uint8_t scan_bit = 0;
void scan_dotmatrix2(uint8_t *data) {
  if (scan_bit == 0) {
    resetCounter();
  }
  shiftOut(~data[scan_bit]);
  tickClock();
  scan_bit = scan_bit < 8 ? scan_bit + 1 : 0;
}

void rotate(uint8_t *oldBuff, uint8_t *newBuff) {
  memset(newBuff, 0, 8);
  for(uint8_t a=0;a<8;a++) {
    for(uint8_t i=0;i<8;i++) {
      newBuff[a] |= (oldBuff[i]&(0x80>>a)) ? (1<<i) : 0;
    }
  }
}

uint8_t frame_buffer[8] = { 0, 0, 0, 0, 0, 0, 0, 0 };
void rotateToBuffer(uint8_t *c) {
  uint8_t newBuff[8];
  rotate(c, newBuff);
  memcpy(frame_buffer, newBuff, 8);
}

uint8_t buffText[(30 * 6) + (8 * 2)]; // Max 30 chars, 2 space for start and end
void showText(char *text) {
  uint8_t inx = 8;
  for(uint8_t cInx=0;cInx<strlen(text);cInx++) {
    for(uint8_t i=0;i<6;i++) {
      buffText[inx++] = font_6_8[(text[cInx] * 6) + i];
    }
  }
  
  for(uint8_t start=0;start<((strlen(text) * 6) + (8));start++) {
    uint8_t buff[8];
    memcpy(buff, &buffText[start], 8);
    rotateToBuffer(buff);
    HAL_Delay(100);
  }
}

void showChar(char c) {
  uint8_t buff[8];
  memset(buff, 0, 8);
  memcpy(&buff[2], &font_6_8[c * 6], 6);
  rotateToBuffer(buff);
}

void HAL_TIM_PeriodElapsedCallback(TIM_HandleTypeDef *htim) {
  scan_dotmatrix2(frame_buffer);
}

/* USER CODE END 0 */

/**
  * @brief  The application entry point.
  * @retval int
  */
int main(void)
{
  /* USER CODE BEGIN 1 */

  /* USER CODE END 1 */

  /* MCU Configuration--------------------------------------------------------*/

  /* Reset of all peripherals, Initializes the Flash interface and the Systick. */
  HAL_Init();

  /* USER CODE BEGIN Init */

  /* USER CODE END Init */

  /* Configure the system clock */
  SystemClock_Config();

  /* USER CODE BEGIN SysInit */

  /* USER CODE END SysInit */

  /* Initialize all configured peripherals */
  MX_GPIO_Init();
  MX_TIM2_Init();
  /* USER CODE BEGIN 2 */
   
	// Setup 74HC595
	HAL_GPIO_WritePin(C_LD_GPIO_Port, C_LD_Pin, 1); // Set CS to HIGH
	HAL_GPIO_WritePin(C_DT_GPIO_Port, C_DT_Pin, 0);
	HAL_GPIO_WritePin(C_CLK_GPIO_Port, C_CLK_Pin, 0);
	
	// Setup 4017
	HAL_GPIO_WritePin(R_RST_GPIO_Port, R_RST_Pin, 0);
	HAL_GPIO_WritePin(R_CLK_GPIO_Port, R_CLK_Pin, 0);
	
	resetCounter();
	shiftOut(0xFF); // trun off all
  
  HAL_TIM_Base_Start_IT(&htim2);
	
  /* USER CODE END 2 */

  /* Infinite loop */
  /* USER CODE BEGIN WHILE */
  while (1)
  {
    showText("E-TECH");
    /* USER CODE END WHILE */

    /* USER CODE BEGIN 3 */
  }
  /* USER CODE END 3 */
}

/**
  * @brief System Clock Configuration
  * @retval None
  */
void SystemClock_Config(void)
{
  RCC_OscInitTypeDef RCC_OscInitStruct = {0};
  RCC_ClkInitTypeDef RCC_ClkInitStruct = {0};

  /** Configure the main internal regulator output voltage 
  */
  __HAL_PWR_VOLTAGESCALING_CONFIG(PWR_REGULATOR_VOLTAGE_SCALE1);
  /** Initializes the CPU, AHB and APB busses clocks 
  */
  RCC_OscInitStruct.OscillatorType = RCC_OSCILLATORTYPE_HSI;
  RCC_OscInitStruct.HSIState = RCC_HSI_ON;
  RCC_OscInitStruct.HSICalibrationValue = RCC_HSICALIBRATION_DEFAULT;
  RCC_OscInitStruct.PLL.PLLState = RCC_PLL_ON;
  RCC_OscInitStruct.PLL.PLLSource = RCC_PLLSOURCE_HSI;
  RCC_OscInitStruct.PLL.PLLMUL = RCC_PLLMUL_4;
  RCC_OscInitStruct.PLL.PLLDIV = RCC_PLLDIV_2;
  if (HAL_RCC_OscConfig(&RCC_OscInitStruct) != HAL_OK)
  {
    Error_Handler();
  }
  /** Initializes the CPU, AHB and APB busses clocks 
  */
  RCC_ClkInitStruct.ClockType = RCC_CLOCKTYPE_HCLK|RCC_CLOCKTYPE_SYSCLK
                              |RCC_CLOCKTYPE_PCLK1|RCC_CLOCKTYPE_PCLK2;
  RCC_ClkInitStruct.SYSCLKSource = RCC_SYSCLKSOURCE_PLLCLK;
  RCC_ClkInitStruct.AHBCLKDivider = RCC_SYSCLK_DIV1;
  RCC_ClkInitStruct.APB1CLKDivider = RCC_HCLK_DIV1;
  RCC_ClkInitStruct.APB2CLKDivider = RCC_HCLK_DIV1;

  if (HAL_RCC_ClockConfig(&RCC_ClkInitStruct, FLASH_LATENCY_1) != HAL_OK)
  {
    Error_Handler();
  }
}

/**
  * @brief TIM2 Initialization Function
  * @param None
  * @retval None
  */
static void MX_TIM2_Init(void)
{

  /* USER CODE BEGIN TIM2_Init 0 */

  /* USER CODE END TIM2_Init 0 */

  TIM_MasterConfigTypeDef sMasterConfig = {0};
  TIM_OC_InitTypeDef sConfigOC = {0};

  /* USER CODE BEGIN TIM2_Init 1 */

  /* USER CODE END TIM2_Init 1 */
  htim2.Instance = TIM2;
  htim2.Init.Prescaler = 32;
  htim2.Init.CounterMode = TIM_COUNTERMODE_UP;
  htim2.Init.Period = 1000;
  htim2.Init.ClockDivision = TIM_CLOCKDIVISION_DIV1;
  htim2.Init.AutoReloadPreload = TIM_AUTORELOAD_PRELOAD_DISABLE;
  if (HAL_TIM_OC_Init(&htim2) != HAL_OK)
  {
    Error_Handler();
  }
  sMasterConfig.MasterOutputTrigger = TIM_TRGO_RESET;
  sMasterConfig.MasterSlaveMode = TIM_MASTERSLAVEMODE_DISABLE;
  if (HAL_TIMEx_MasterConfigSynchronization(&htim2, &sMasterConfig) != HAL_OK)
  {
    Error_Handler();
  }
  sConfigOC.OCMode = TIM_OCMODE_TIMING;
  sConfigOC.Pulse = 0;
  sConfigOC.OCPolarity = TIM_OCPOLARITY_HIGH;
  sConfigOC.OCFastMode = TIM_OCFAST_DISABLE;
  if (HAL_TIM_OC_ConfigChannel(&htim2, &sConfigOC, TIM_CHANNEL_1) != HAL_OK)
  {
    Error_Handler();
  }
  /* USER CODE BEGIN TIM2_Init 2 */

  /* USER CODE END TIM2_Init 2 */

}

/**
  * @brief GPIO Initialization Function
  * @param None
  * @retval None
  */
static void MX_GPIO_Init(void)
{
  GPIO_InitTypeDef GPIO_InitStruct = {0};

  /* GPIO Ports Clock Enable */
  __HAL_RCC_GPIOC_CLK_ENABLE();

  /*Configure GPIO pin Output Level */
  HAL_GPIO_WritePin(GPIOC, R_RST_Pin|R_CLK_Pin|C_DT_Pin|C_CLK_Pin 
                          |C_LD_Pin, GPIO_PIN_RESET);

  /*Configure GPIO pins : R_RST_Pin R_CLK_Pin C_DT_Pin C_CLK_Pin 
                           C_LD_Pin */
  GPIO_InitStruct.Pin = R_RST_Pin|R_CLK_Pin|C_DT_Pin|C_CLK_Pin 
                          |C_LD_Pin;
  GPIO_InitStruct.Mode = GPIO_MODE_OUTPUT_PP;
  GPIO_InitStruct.Pull = GPIO_NOPULL;
  GPIO_InitStruct.Speed = GPIO_SPEED_FREQ_LOW;
  HAL_GPIO_Init(GPIOC, &GPIO_InitStruct);

}

/* USER CODE BEGIN 4 */

/* USER CODE END 4 */

/**
  * @brief  This function is executed in case of error occurrence.
  * @retval None
  */
void Error_Handler(void)
{
  /* USER CODE BEGIN Error_Handler_Debug */
  /* User can add his own implementation to report the HAL error return state */

  /* USER CODE END Error_Handler_Debug */
}

#ifdef  USE_FULL_ASSERT
/**
  * @brief  Reports the name of the source file and the source line number
  *         where the assert_param error has occurred.
  * @param  file: pointer to the source file name
  * @param  line: assert_param error line source number
  * @retval None
  */
void assert_failed(uint8_t *file, uint32_t line)
{ 
  /* USER CODE BEGIN 6 */
  /* User can add his own implementation to report the file name and line number,
     tex: printf("Wrong parameters value: file %s on line %d\r\n", file, line) */
  /* USER CODE END 6 */
}
#endif /* USE_FULL_ASSERT */

/************************ (C) COPYRIGHT STMicroelectronics *****END OF FILE****/
